## firmware/main/Kconfig.projbuild
```kconfig
menu "Whale Maid voice"

config WHALE_VOICE_ENABLED
    bool "Enable offline Hi ESP response and push-to-talk"
    default y
    help
        Say Hi ESP for an offline wave and chime without Wi-Fi, then say
        "hui shou", "tiao yi xia" or "shui jiao" within 6 seconds to drive
        the wave, jump or sleep animation.
        Hold BOOT to stream 16 kHz mono PCM audio to the configured bridge.
        Touch remains available for changing the fixed character action.

config WHALE_WIFI_SSID
    string "Wi-Fi SSID"
    default ""
    depends on WHALE_VOICE_ENABLED

config WHALE_WIFI_PASSWORD
    string "Wi-Fi password"
    default ""
    depends on WHALE_VOICE_ENABLED

config WHALE_MIC_GAIN_DB
    int "Microphone gain (dB)"
    range 0 45
    default 30
    depends on WHALE_VOICE_ENABLED

config WHALE_SPEAKER_VOLUME
    int "Speaker volume (0-100)"
    range 0 100
    default 65
    depends on WHALE_VOICE_ENABLED

endmenu
```

## firmware/sdkconfig.defaults
```kconfig
CONFIG_IDF_TARGET="esp32s3"
CONFIG_ESPTOOLPY_FLASHMODE_QIO=y
CONFIG_ESPTOOLPY_FLASHSIZE_32MB=y
CONFIG_PARTITION_TABLE_CUSTOM=y
CONFIG_COMPILER_OPTIMIZATION_PERF=y
CONFIG_SPIRAM=y
CONFIG_SPIRAM_MODE_OCT=y
CONFIG_SPIRAM_SPEED_80M=y
CONFIG_SPIRAM_MALLOC_ALWAYSINTERNAL=16384
CONFIG_SPIRAM_MALLOC_RESERVE_INTERNAL=65536
CONFIG_ESP_DEFAULT_CPU_FREQ_MHZ_240=y
CONFIG_ESP_CONSOLE_USB_SERIAL_JTAG=y
CONFIG_FREERTOS_HZ=1000
CONFIG_LV_USE_CANVAS=y
CONFIG_LV_USE_CLIB_MALLOC=y
CONFIG_LV_USE_CLIB_STRING=y
CONFIG_LV_USE_CLIB_SPRINTF=y
CONFIG_LV_OS_FREERTOS=y
CONFIG_LV_DEF_REFR_PERIOD=16
CONFIG_BSP_DISPLAY_LVGL_BUF_HEIGHT=20
CONFIG_LV_USE_SYSMON=n
CONFIG_LV_USE_PERF_MONITOR=n
CONFIG_WHALE_VOICE_ENABLED=y
CONFIG_SR_WN_WN9_HIESP=y
CONFIG_SR_MN_CN_MULTINET7_QUANT=y
CONFIG_SR_MN_EN_NONE=y
CONFIG_SR_VADN_VADNET1_MEDIUM=y
CONFIG_LWIP_SNTP_MAX_SERVERS=3
CONFIG_LWIP_TCP_WND_DEFAULT=65534
CONFIG_LWIP_TCP_RECVMBOX_SIZE=32
CONFIG_MBEDTLS_CERTIFICATE_BUNDLE_CROSS_SIGNED_VERIFY=y
```
